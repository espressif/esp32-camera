## Kconfig
```kconfig
menu "Camera configuration"
      
config OV2640_SUPPORT
	bool "OV2640 Support"
	default y
	help
		Enable this option if you want to use the OV2640.
		Disable this option to save memory.

config OV7670_SUPPORT
	bool "OV7670 Support"
	default y
	help
		Enable this option if you want to use the OV7670.
		Disable this option to safe memory.

config OV7725_SUPPORT
	bool "OV7725 Support"
	default n
	help
		Enable this option if you want to use the OV7725.
		Disable this option to save memory.
	
config OV3660_SUPPORT
    bool "OV3660 Support"
    default y
    help
        Enable this option if you want to use the OV3360.
        Disable this option to save memory.
    
config OV5640_SUPPORT
    bool "OV5640 Support"
    default y
    help
        Enable this option if you want to use the OV5640.
        Disable this option to save memory.
    
choice SCCB_HARDWARE_I2C_PORT
    bool "I2C peripheral to use for SCCB"
    default SCCB_HARDWARE_I2C_PORT1

    config SCCB_HARDWARE_I2C_PORT0
        bool "I2C0"
    config SCCB_HARDWARE_I2C_PORT1
        bool "I2C1"

endchoice

choice CAMERA_TASK_PINNED_TO_CORE
    bool "Camera task pinned to core"
    default CAMERA_CORE0
    help
        Pin the camera handle task to a certain core(0/1). It can also be done automatically choosing NO_AFFINITY.

    config CAMERA_CORE0
        bool "CORE0"
    config CAMERA_CORE1
        bool "CORE1"
    config CAMERA_NO_AFFINITY
        bool "NO_AFFINITY"

endchoice
    
endmenu
```

## examples/basic/sdkconfig.defaults
```kconfig
CONFIG_ESP32_DEFAULT_CPU_FREQ_240=y
CONFIG_ESP32S2_DEFAULT_CPU_FREQ_240=y
CONFIG_ESP32S3_DEFAULT_CPU_FREQ_240=y

CONFIG_ESPTOOLPY_FLASHFREQ_80M=y
CONFIG_ESPTOOLPY_FLASHMODE_QIO=y
CONFIG_ESPTOOLPY_FLASHSIZE_4MB=y

CONFIG_FREERTOS_HZ=1000

CONFIG_SPIRAM_SUPPORT=y
CONFIG_ESP32_SPIRAM_SUPPORT=y
CONFIG_ESP32S2_SPIRAM_SUPPORT=y
CONFIG_ESP32S3_SPIRAM_SUPPORT=y
CONFIG_SPIRAM_MODE_OCT=y
CONFIG_SPIRAM_SPEED_80M=y
CONFIG_SPIRAM_MEMTEST=n

CONFIG_SPIRAM_MALLOC_ALWAYSINTERNAL=1580
CONFIG_FREERTOS_IDLE_TASK_STACKSIZE=1536

CONFIG_BOOTLOADER_SKIP_VALIDATE_IN_DEEP_SLEEP=y
CONFIG_BOOTLOADER_SKIP_VALIDATE_ON_POWER_ON=y
CONFIG_BOOTLOADER_SKIP_VALIDATE_ALWAYS=y
```

## examples/camera_example_common/Kconfig.projbuild
```kconfig
menu "Camera Pin Configuration"

    choice CAMERA_MODULE
        bool "Select Camera Pinout"
        default CAMERA_MODULE_WROVER_KIT
        help
            Select Camera Pinout.

        config CAMERA_MODULE_WROVER_KIT
            bool "WROVER-KIT With OV2640 Module"
        config CAMERA_MODULE_ESP_EYE
            bool "ESP-EYE DevKit"
        config CAMERA_MODULE_ESP_S2_KALUGA
            bool "ESP32-S2-Kaluga-1 V1.3"
        config CAMERA_MODULE_ESP_S3_EYE
            bool "ESP-S3-EYE DevKit"
        config CAMERA_MODEL_ESP32_CAM_BOARD
            bool "ESP32 Camera Development Board"
        config CAMERA_MODULE_M5STACK_PSRAM
            bool "M5Stack Camera With PSRAM"
        config CAMERA_MODULE_M5STACK_WIDE
            bool "M5Stack Camera F (Wide)"
        config CAMERA_MODULE_AI_THINKER
            bool "ESP32-CAM by AI-Thinker"
        config CAMERA_MODULE_CUSTOM
            bool "Custom Camera Pinout"
    endchoice

    config CAMERA_PIN_PWDN
        depends on CAMERA_MODULE_CUSTOM
        int "Power Down pin"
        range -1 33
        default -1
        help
            Select Power Down pin or -1 for unmanaged.

    config CAMERA_PIN_RESET
        depends on CAMERA_MODULE_CUSTOM
        int "Reset pin"
        range -1 33
        default -1
        help
            Select Camera Reset pin or -1 for software reset.

    config CAMERA_PIN_XCLK
        depends on CAMERA_MODULE_CUSTOM
        int "XCLK pin"
        range 0 33
        default 21
        help
            Select Camera XCLK pin.

    config CAMERA_PIN_SIOD
        depends on CAMERA_MODULE_CUSTOM
        int "SIOD pin"
        range 0 33
        default 26
        help
            Select Camera SIOD pin.

    config CAMERA_PIN_SIOC
        depends on CAMERA_MODULE_CUSTOM
        int "SIOC pin"
        range 0 33
        default 27
        help
            Select Camera SIOC pin.

    config CAMERA_PIN_VSYNC
        depends on CAMERA_MODULE_CUSTOM
        int "VSYNC pin"
        range 0 39
        default 25
        help
            Select Camera VSYNC pin.

    config CAMERA_PIN_HREF
        depends on CAMERA_MODULE_CUSTOM
        int "HREF pin"
        range 0 39
        default 23
        help
            Select Camera HREF pin.

    config CAMERA_PIN_PCLK
        depends on CAMERA_MODULE_CUSTOM
        int "PCLK pin"
        range 0 39
        default 25
        help
            Select Camera PCLK pin.

    config CAMERA_PIN_Y2
        depends on CAMERA_MODULE_CUSTOM
        int "Y2 pin"
        range 0 39
        default 4
        help
            Select Camera Y2 pin.

    config CAMERA_PIN_Y3
        depends on CAMERA_MODULE_CUSTOM
        int "Y3 pin"
        range 0 39
        default 5
        help
            Select Camera Y3 pin.

    config CAMERA_PIN_Y4
        depends on CAMERA_MODULE_CUSTOM
        int "Y4 pin"
        range 0 39
        default 18
        help
            Select Camera Y4 pin.

    config CAMERA_PIN_Y5
        depends on CAMERA_MODULE_CUSTOM
        int "Y5 pin"
        range 0 39
        default 19
        help
            Select Camera Y5 pin.

    config CAMERA_PIN_Y6
        depends on CAMERA_MODULE_CUSTOM
        int "Y6 pin"
        range 0 39
        default 36
        help
            Select Camera Y6 pin.

    config CAMERA_PIN_Y7
        depends on CAMERA_MODULE_CUSTOM
        int "Y7 pin"
        range 0 39
        default 39
        help
            Select Camera Y7 pin.

    config CAMERA_PIN_Y8
        depends on CAMERA_MODULE_CUSTOM
        int "Y8 pin"
        range 0 39
        default 34
        help
            Select Camera Y8 pin.

    config CAMERA_PIN_Y9
        depends on CAMERA_MODULE_CUSTOM
        int "Y9 pin"
        range 0 39
        default 35
        help
            Select Camera Y9 pin.
endmenu
```
